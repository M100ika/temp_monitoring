## platform_test/pio_espidf/sdkconfig.defaults
```kconfig
# ESP32-C6-LCD-1.47 (Waveshare) — 4MB Flash
CONFIG_ESPTOOLPY_FLASHSIZE_4MB=y
CONFIG_ESPTOOLPY_FLASHSIZE="4MB"

# SPI Flash speed
CONFIG_ESPTOOLPY_FLASHFREQ_80M=y

# FreeRTOS tick rate (1000 Hz = 1ms resolution)
CONFIG_FREERTOS_HZ=1000

# Optimize for size
CONFIG_COMPILER_OPTIMIZATION_SIZE=y
```

## sdkconfig.defaults
```kconfig
# ESP32-C6 — 8 MB embedded flash (ESP32-C6FH8)
# Eliminates "Flash memory size mismatch" warning from esptool
CONFIG_ESPTOOLPY_FLASHSIZE_8MB=y
CONFIG_ESPTOOLPY_FLASHSIZE="8MB"
CONFIG_ESPTOOLPY_FLASHMODE_QIO=y
CONFIG_ESPTOOLPY_FLASHFREQ_80M=y
```
